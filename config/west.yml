## config/west.yml
```yaml
manifest:
  remotes:
    - name: paramSonawane
      url-base: https://github.com/paramSonawane
    - name: caksoylar
      url-base: https://github.com/caksoylar
  projects:
    - name: zmk
      remote: paramSonawane
      revision: upstream-mouse-support-linux
      import: app/west.yml
    - name: zmk-rgbled-widget
      remote: caksoylar
      revision: main
  self:
    path: config
```
